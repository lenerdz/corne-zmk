## Kconfig
```kconfig
# SPDX-License-Identifier: MIT

config ZMK_STENO_GEMINI
	bool "GeminiPR steno keys (&stn)"
	default y
	depends on DT_HAS_ZMK_BEHAVIOR_STENO_GEMINI_ENABLED
	help
	  The &stn behavior: each key of a chord adds one bit to a GeminiPR packet,
	  and the packet is sent to the host when the last key of the chord is
	  released. The packet goes out through the CDC ACM serial port that the
	  devicetree node labelled gemini_uart declares (only the half that talks
	  to the computer has it; on the other half the behavior builds but does
	  nothing, because behaviors with central locality only run on the central).
	  Plover reads the packets with its "Gemini PR" machine.

config ZMK_STENO_GEMINI_REQUIRE_DTR
	bool "Send chords only while the host has the serial port open"
	default y
	depends on ZMK_STENO_GEMINI && SERIAL
	select UART_LINE_CTRL
	help
	  The host raises the DTR line when a program (Plover) opens the serial
	  port, and drops it when the program closes the port. With this option a
	  chord is sent only while DTR is high; otherwise it is dropped. Without it
	  the chords typed while nobody has the port open pile up in the USB buffer
	  and reach Plover later, as strokes nobody typed just then.

	  Turn it off (CONFIG_ZMK_STENO_GEMINI_REQUIRE_DTR=n) only to find out
	  whether a host that never raises DTR is why no chord arrives.
```

## dts/bindings/behaviors/zmk,behavior-steno-gemini.yaml
```yaml
# SPDX-License-Identifier: MIT

description: |
  GeminiPR steno key. The parameter is the number of one steno key (the STN_*
  macros of <dt-bindings/steno/gemini.h>). The key adds its bit to the chord
  being typed, and the whole chord is sent as one 6 byte GeminiPR packet over
  the serial port labelled gemini_uart when the last key is released.

compatible: "zmk,behavior-steno-gemini"

include: one_param.yaml
```

## rgb-key/Kconfig
```kconfig
config ZMK_BEHAVIOR_RGB_KEY
    bool "RGB Key behavior"
    default y
    depends on DT_HAS_ZMK_BEHAVIOR_RGB_KEY_ENABLED
```

## rgb-key/dts/bindings/behaviors/zmk,behavior-rgb-key.yaml
```yaml
description: Set an individual RGB LED color

compatible: "zmk,behavior-rgb-key"

include: two_param.yaml
```
